## poky-dep/meta-sargas/conf/layer.conf
```bitbake
# We have a conf and classes directory, add to BBPATH
BBPATH =. "${LAYERDIR}:"

# We have recipes-* directories, add to BBFILES
BBFILES += "${LAYERDIR}/recipes-*/*/*.bb \
            ${LAYERDIR}/recipes-*/*/*.bbappend"

BBFILE_COLLECTIONS += "sargas"
BBFILE_PATTERN_sargas= "^${LAYERDIR}/"
BBFILE_PRIORITY_sargas= "5"

LAYERVERSION_sargas = "1"
```
